## Kconfig
```
# Copyright (c) 2023 Nordic Semiconductor ASA
# SPDX-License-Identifier: Apache-2.0

source "Kconfig.zephyr"

mainmenu "LVGL Sample"

config RESET_COUNTER_SWLVGL_COLOR_16_SWAP0
	bool "Reset counter when sw0 is pressed"
	depends on $(dt_alias_enabled,sw0)
	select GPIO
	default y

# config ST7735R
# 	bool "ST7735R/ST7735S display driver"
# 	default y
# 	depends on DT_HAS_SITRONIX_ST7735R_ENABLED
# 	select MIPI_DBI
# 	help
# 	  Enable driver for ST7735R/ST7735S display driver.

# config LVGL_COLOR_16_SWAP
#     bool "RGB565 byte swap"
#     depends on LVGL_COLOR_DEPTH_16 && LVGL
#     help
#       Swap the 2 bytes of a RGB565 pixel.

# config LVGL_FONT_SUBPX_BGR
#     bool "Use BGR instead RGB for sub-pixel rendering"
#     depends on LVGL
#     help
#       User BGR pixel format instead of RGB for sub-pixel rendering
```

## prj.conf
```kconfig
CONFIG_LV_Z_MEM_POOL_SIZE=16384
CONFIG_LV_Z_SHELL=y
CONFIG_MAIN_STACK_SIZE=4096

CONFIG_DISPLAY=y
CONFIG_DISPLAY_LOG_LEVEL_ERR=y

# CONFIG_LOG=y
# CONFIG_SHELL=y

CONFIG_LVGL=y
CONFIG_LV_USE_LOG=y
CONFIG_LV_USE_LABEL=y
CONFIG_LV_USE_ARC=y
CONFIG_LV_USE_MONKEY=y
CONFIG_LV_FONT_MONTSERRAT_14=y

## 控制台相关配置        # 保持开启 13.9776 kb
CONFIG_SHELL=y          # 使能AT shell
CONFIG_ASSERT=y         # 开启断言
CONFIG_PRINTK=n         # 使能printk(函数) 参考：https://academy.nordicsemi.com/courses/nrf-connect-sdk-fundamentals/lessons/lesson-3-printing-messages-to-console-and-logging/topic/printk-function/
# Enable RTT            # link sphere 未接usart，需开启RTT控台查看调试信息
CONFIG_USE_SEGGER_RTT=y
# Console               # nrf52833
CONFIG_CONSOLE=y
# 终端为RTT/串口 配置说明：https://docs.nordicsemi.com/bundle/ncs-1.6.1/page/nrf/gs_testing.html
CONFIG_RTT_CONSOLE=y    # 使用J-Link RTT Viewer 控台调试
CONFIG_UART_CONSOLE=n   # 使用 PuTTy 控台调试 配置说明：https://docs.nordicsemi.com/bundle/ncs-1.6.1/page/nrf/ug_logging.html#ug-logging-backends
CONFIG_STDOUT_CONSOLE=y # 使能printf定向到控制台(默认串口输出)
CONFIG_EARLY_CONSOLE=n  # Send stdout at the earliest stage possible

## 因工程应用需要的存储空间角度，发布时需要关闭日志功能 13.4144 kb
## 日志相关配置 https://docs.nordicsemi.com/bundle/ncs-1.6.1/page/nrf/ug_logging.html#ug-logging-backends
CONFIG_LOG=y    #y
CONFIG_LOG_BACKEND_RTT=y    #y
CONFIG_LOG_BACKEND_UART=n
# 使能printk定向到控制台
CONFIG_LOG_PRINTK=n
# 设置PWM日志级别
CONFIG_PWM_LOG_LEVEL_DBG=n
# 仿真日志缓冲区溢出
CONFIG_LOG_MODE_IMMEDIATE=n

#LVGL 配置
CONFIG_LV_COLOR_DEPTH_16=y
CONFIG_LV_COLOR_16_SWAP=y
```

## src/main.c
```c
/*
 * Copyright (c) 2018 Jan Van Winkel <jan.van_winkel@dxplore.eu>
 *
 * SPDX-License-Identifier: Apache-2.0
 */

#include <zephyr/device.h>
#include <zephyr/devicetree.h>
#include <zephyr/drivers/display.h>
#include <zephyr/drivers/gpio.h>
#include <lvgl.h>
#include <stdio.h>
#include <string.h>
#include <zephyr/kernel.h>
#include <lvgl_input_device.h>

#define LOG_LEVEL CONFIG_LOG_DEFAULT_LEVEL
#include <zephyr/logging/log.h>
LOG_MODULE_REGISTER(app);

static uint32_t count;

#ifdef CONFIG_RESET_COUNTER_SW0
static struct gpio_dt_spec button_gpio = GPIO_DT_SPEC_GET_OR(
		DT_ALIAS(sw0), gpios, {0});
static struct gpio_callback button_callback;

static void button_isr_callback(const struct device *port,
				struct gpio_callback *cb,
				uint32_t pins)
{
	ARG_UNUSED(port);
	ARG_UNUSED(cb);
	ARG_UNUSED(pins);

	count = 0;
}
#endif /* CONFIG_RESET_COUNTER_SW0 */

#ifdef CONFIG_LV_Z_ENCODER_INPUT
static const struct device *lvgl_encoder =
	DEVICE_DT_GET(DT_COMPAT_GET_ANY_STATUS_OKAY(zephyr_lvgl_encoder_input));
#endif /* CONFIG_LV_Z_ENCODER_INPUT */

#ifdef CONFIG_LV_Z_KEYPAD_INPUT
static const struct device *lvgl_keypad =
	DEVICE_DT_GET(DT_COMPAT_GET_ANY_STATUS_OKAY(zephyr_lvgl_keypad_input));
#endif /* CONFIG_LV_Z_KEYPAD_INPUT */

// static void lv_btn_click_callback(lv_event_t *e)
// {
// 	ARG_UNUSED(e);

// 	count = 0;
// }

void lv_image_test(void)
{
	// lv_obj_t * img1 = lv_image_create(lv_screen_active());
	// LV_IMAGE_DECLARE(backdrop);
    // lv_image_set_src(img1, &backdrop);
    // lv_obj_align(img1, LV_ALIGN_CENTER, 0, 0);

	lv_obj_t * img1 = lv_image_create(lv_screen_active());
	LV_IMAGE_DECLARE(foreground);
    lv_image_set_src(img1, &foreground);
    lv_obj_align(img1, LV_ALIGN_CENTER, 0, 0);
}

int main(void)
{
	// char count_str[11] = {0};
	const struct device *display_dev;
	// lv_obj_t *hello_world_label;
	// lv_obj_t *count_label;

	display_dev = DEVICE_DT_GET(DT_CHOSEN(zephyr_display));
	if (!device_is_ready(display_dev)) {
		LOG_ERR("Device not ready, aborting test");
		return 0;
	}

	/* Set background color to white */
	static lv_style_t style_screen;
	lv_style_init(&style_screen);
	// lv_style_set_bg_color(&style_screen, lv_color_white());
	lv_style_set_bg_color(&style_screen, lv_color_black());
	lv_obj_add_style(lv_scr_act(), &style_screen, 0);

// #ifdef CONFIG_RESET_COUNTER_SW0
// 	if (gpio_is_ready_dt(&button_gpio)) {
// 		int err;

// 		err = gpio_pin_configure_dt(&button_gpio, GPIO_INPUT);
// 		if (err) {
// 			LOG_ERR("failed to configure button gpio: %d", err);
// 			return 0;
// 		}

// 		gpio_init_callback(&button_callback, button_isr_callback,
// 				   BIT(button_gpio.pin));

// 		err = gpio_add_callback(button_gpio.port, &button_callback);
// 		if (err) {
// 			LOG_ERR("failed to add button callback: %d", err);
// 			return 0;
// 		}

// 		err = gpio_pin_interrupt_configure_dt(&button_gpio,
// 						      GPIO_INT_EDGE_TO_ACTIVE);
// 		if (err) {
// 			LOG_ERR("failed to enable button callback: %d", err);
// 			return 0;
// 		}
// 	}
// #endif /* CONFIG_RESET_COUNTER_SW0 */

// #ifdef CONFIG_LV_Z_ENCODER_INPUT
// 	lv_obj_t *arc;
// 	lv_group_t *arc_group;

// 	arc = lv_arc_create(lv_screen_active());
// 	lv_obj_align(arc, LV_ALIGN_CENTER, 0, -15);
// 	lv_obj_set_size(arc, 150, 150);

// 	arc_group = lv_group_create();
// 	lv_group_add_obj(arc_group, arc);
// 	lv_indev_set_group(lvgl_input_get_indev(lvgl_encoder), arc_group);
// #endif /* CONFIG_LV_Z_ENCODER_INPUT */

// #ifdef CONFIG_LV_Z_KEYPAD_INPUT
// 	lv_obj_t *btn_matrix;
// 	lv_group_t *btn_matrix_group;
// 	static const char *const btnm_map[] = {"1", "2", "3", "4", ""};

// 	btn_matrix = lv_buttonmatrix_create(lv_screen_active());
// 	lv_obj_align(btn_matrix, LV_ALIGN_CENTER, 0, 70);
// 	lv_buttonmatrix_set_map(btn_matrix, (const char **)btnm_map);
// 	lv_obj_set_size(btn_matrix, 100, 50);

// 	btn_matrix_group = lv_group_create();
// 	lv_group_add_obj(btn_matrix_group, btn_matrix);
// 	lv_indev_set_group(lvgl_input_get_indev(lvgl_keypad), btn_matrix_group);
// #endif /* CONFIG_LV_Z_KEYPAD_INPUT */

	// if (IS_ENABLED(CONFIG_LV_Z_POINTER_INPUT)) {
	// 	lv_obj_t *hello_world_button;

	// 	hello_world_button = lv_button_create(lv_screen_active());
	// 	lv_obj_align(hello_world_button, LV_ALIGN_CENTER, 0, -15);
	// 	lv_obj_add_event_cb(hello_world_button, lv_btn_click_callback, LV_EVENT_CLICKED,
	// 			    NULL);
	// 	hello_world_label = lv_label_create(hello_world_button);
	// } else {
	// 	hello_world_label = lv_label_create(lv_screen_active());
	// }

	// lv_label_set_text(hello_world_label, "Hello!");
	// lv_obj_align(hello_world_label, LV_ALIGN_CENTER, 0, 0);

	// count_label = lv_label_create(lv_screen_active());
	// lv_obj_align(count_label, LV_ALIGN_BOTTOM_MID, 0, 0);

	/* Set background color to white */
	static lv_style_t style_screen;
	lv_style_init(&style_screen);
	lv_style_set_bg_color(&style_screen, lv_color_white());
	lv_obj_add_style(lv_scr_act(), &style_screen, 0);

	// lv_image_test();


	lv_timer_handler();
	display_blanking_off(display_dev);
	while (1) {
		// if ((count % 100) == 0U) {
		// 	sprintf(count_str, "%d", count/100U);
		// 	lv_label_set_text(count_label, count_str);
		// }
		lv_timer_handler();
		// ++count;
		// LOG_INF("mian run %d",count);
		k_sleep(K_MSEC(10));
	}
}
```
